#include "uart_nrf52_rv1126.h"
#include "uart.h"
#include "nrf_log.h"
#include "app_uart.h"
#include "main.h"


uint8_t m_rx_buffer[64] = {0};
uint32_t rx_idx = 0;
uint8_t m_tx_buffer[64] = {0};

static uint16_t crc16_table[256] = {
0x0000, 0x1189, 0x2312, 0x329b, 0x4624, 0x57ad, 0x6536, 0x74bf,
0x8c48, 0x9dc1, 0xaf5a, 0xbed3, 0xca6c, 0xdbe5, 0xe97e, 0xf8f7,
0x1081, 0x0108, 0x3393, 0x221a, 0x56a5, 0x472c, 0x75b7, 0x643e,
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0x7bc7, 0x6a4e, 0x58d5, 0x495c, 0x3de3, 0x2c6a, 0x1ef1, 0x0f78
};

uint16_t get_crc_value(uint8_t * data, uint32_t length)
{
    uint16_t crc_reg = 0xFFFF;
    while (length--)
    {
        crc_reg = (crc_reg >> 8) ^ crc16_table[(crc_reg ^ *data++) & 0xff];
    }
    
    return (uint16_t)(~crc_reg) & 0x0000FFFF;
}

uint16_t crc_value;
bool crc_check_do(uint8_t * data, uint32_t length, uint16_t right_crc_value)
{
    crc_value = get_crc_value(data, length);

    if (crc_value != right_crc_value)
        return false;
    else
        return true;
}


uint32_t uart_nrf52_rv1126_send_cmd(uint8_t *p_tx_buf, nrf_rv1126_cmd_t cmd_type)
{
    uint32_t ret_code;
    nrf_rv1126_uart_handle p_nru = (nrf_rv1126_uart_handle)p_tx_buf;
    
    p_nru->start_code = NRU_START_CODE;
    p_nru->cmd = (uint16_t)cmd_type;

    p_nru->crc = get_crc_value((uint8_t *)p_nru, NRC_LEN - CRC_LEN);

    ret_code = uart_send(p_tx_buf, sizeof(nrf_rv1126_uart_t));

    return ret_code;
}

void reset_rx_buffer(void)
{
    memset(m_rx_buffer, 0, sizeof(m_rx_buffer));
    rx_idx = 0;
}

uint32_t uart_nrf52_rv1126_get_cmd(uint8_t *p_rx_buf, uint32_t *p_idx)
{
    uint8_t cr = 0;
    if(app_uart_get(&cr) == NRF_SUCCESS)
    {
        switch(*p_idx)
        {
            // idx 0-3 为 NRU_START_CODE
            case 0:
            case 1:
            case 2:
            case 3:
            {
                if(cr == 0xFF)
                {
                    p_rx_buf[(*p_idx)++] = cr;
                }
                else
                    reset_rx_buffer();
                break;
            }
            default:
                p_rx_buf[(*p_idx)++] = cr;
                break;
        }
        
        // 收到一条完整命令
        if((*p_idx) == NRC_LEN)   
        {
            nrf_rv1126_uart_handle p_rx_cmd = (nrf_rv1126_uart_handle)p_rx_buf;

            if (crc_check_do(p_rx_buf, NRC_LEN - CRC_LEN, p_rx_cmd->crc) == true)
            {
                switch(p_rx_cmd->cmd)
                {
                    case R2N_CMD_TYPE_DELETE_BONDS:
                        delete_bonds();
                        break;
                    default:
                        break;
                }
                reset_rx_buffer();
            }
            else
            {
                reset_rx_buffer();
            }
        }
        return UART_GET_SUCCESS;
    }

    else
        return UART_GET_FAILED;
}

